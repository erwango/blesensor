## CMakeLists.txt
```
# SPDX-License-Identifier: Apache-2.0

cmake_minimum_required(VERSION 3.13.1)

if(NOT ("${BOARD}" STREQUAL "disco_l475_iot1"))
set(SHIELD x_nucleo_iks01a1)
endif()
include($ENV{ZEPHYR_BASE}/cmake/app/boilerplate.cmake NO_POLICY_SCOPE)
project(blesensor)

target_sources(app PRIVATE
  src/main.c
  src/environmental.c
#  src/quaternions.c
  src/command.c

)

zephyr_library_include_directories($ENV{ZEPHYR_BASE}/samples/bluetooth)
```

## prj.conf
```kconfig
# Incresed stack due to settings API usage
CONFIG_SYSTEM_WORKQUEUE_STACK_SIZE=2048

CONFIG_BT=y
CONFIG_BT_DEBUG_LOG=y
CONFIG_BT_SMP=y
CONFIG_BT_SIGNING=y
CONFIG_BT_PERIPHERAL=y
CONFIG_BT_GATT_DIS=y
CONFIG_BT_ATT_PREPARE_COUNT=5
CONFIG_BT_PRIVACY=y
CONFIG_BT_DEVICE_NAME="AM1V340"
CONFIG_BT_DEVICE_APPEARANCE=833
CONFIG_BT_DEVICE_NAME_DYNAMIC=y
CONFIG_BT_DEVICE_NAME_MAX=65

CONFIG_BT_SETTINGS=y
CONFIG_FLASH=y
CONFIG_FLASH_PAGE_LAYOUT=y
CONFIG_FLASH_MAP=y
CONFIG_FCB=y
CONFIG_SETTINGS=y
CONFIG_SETTINGS_FCB=y
CONFIG_NEWLIB_LIBC=y

CONFIG_STDOUT_CONSOLE=y
CONFIG_I2C=y
CONFIG_I2C_STM32_INTERRUPT=y
CONFIG_SENSOR=y

CONFIG_HTS221=y
CONFIG_LIS3MDL=y
CONFIG_HTS221_TRIGGER_NONE=y
CONFIG_LIS3MDL_TRIGGER_NONE=y


CONFIG_LPS25HB=y
CONFIG_LSM6DS0=y


CONFIG_PRINTK=y
```

## boards/disco_l475_iot1.conf
```kconfig
CONFIG_LPS25HB=n
CONFIG_LSM6DS0=n
CONFIG_LPS22HB=y
CONFIG_LSM6DSL=y
```

## src/main.c
```c
#include <zephyr/types.h>
#include <stddef.h>
#include <string.h>
#include <errno.h>
#include <sys/printk.h>
#include <sys/byteorder.h>
#include <zephyr.h>

#include <settings/settings.h>

#include <bluetooth/bluetooth.h>
#include <bluetooth/hci.h>
#include <bluetooth/conn.h>
#include <bluetooth/uuid.h>
#include <bluetooth/gatt.h>

#include <bluetooth/services/hrs.h>
#include <bluetooth/services/bas.h>

#include <device.h>
#include <drivers/sensor.h>
#include <stdio.h>
#include <sys/util.h>

#include "main.h"

#define DEVICE_NAME CONFIG_BT_DEVICE_NAME
#define DEVICE_NAME_LEN (sizeof(DEVICE_NAME) - 1)


//BT manufaturer data
static uint8_t manuf_data[] = {
	0x01, 0x80, 0x5C, 0xFD, 0x01, 0x5A,
	0xC0, 0x86, 0x50, 0x35, 0x31, 0x42};

//BT Data to establish the connexion with the phone
static const struct bt_data ad[] = {
	BT_DATA_BYTES(BT_DATA_FLAGS, (BT_LE_AD_GENERAL | BT_LE_AD_NO_BREDR)),
	BT_DATA(BT_DATA_NAME_COMPLETE, DEVICE_NAME, DEVICE_NAME_LEN),
	BT_DATA_BYTES(BT_DATA_TX_POWER, 0x00),
	BT_DATA(BT_DATA_MANUFACTURER_DATA, manuf_data, 12),
};


static void connected(struct bt_conn *conn, u8_t err)
{
	if (err) {
		printk("Connection failed (err %u)\n", err);
	} else {
		printk("\n------------- Connected -------------\n");
	}
}

static void disconnected(struct bt_conn *conn, u8_t reason)
{
	printk("\n-------------Disconnected (reason %u)-------------\n", reason);
}


static struct bt_conn_cb conn_callbacks = {
	.connected = connected,
	.disconnected = disconnected,
};


static void bt_ready(int err)
{
	if (err) {
		printk("Bluetooth init failed (err %d)\n", err);
		return;
	}

	printk("Bluetooth initialized\n");

	if (IS_ENABLED(CONFIG_SETTINGS)) {
		settings_load();
	}

	err = bt_le_adv_start(BT_LE_ADV_CONN_NAME, ad, ARRAY_SIZE(ad), NULL, 0);
	if (err) {
		printk("Advertising failed to start (err %d)\n", err);
		return;
	}

	printk("Advertising successfully started\n");
}


static void auth_passkey_display(struct bt_conn *conn, unsigned int passkey)
{
	char addr[BT_ADDR_LE_STR_LEN];

	bt_addr_le_to_str(bt_conn_get_dst(conn), addr, sizeof(addr));

	printk("Passkey for %s: %06u\n", addr, passkey);
}


static void auth_cancel(struct bt_conn *conn)
{
	char addr[BT_ADDR_LE_STR_LEN];

	bt_addr_le_to_str(bt_conn_get_dst(conn), addr, sizeof(addr));

	printk("Pairing cancelled: %s\n", addr);
}


static struct bt_conn_auth_cb auth_cb_display = {
	.passkey_display = auth_passkey_display,
	.passkey_entry = NULL,
	.cancel = auth_cancel,
};


void main(void)
{

	int err;
	err = bt_enable(bt_ready);
	if (err) {
		printk("Bluetooth init failed (err %d)\n", err);
		return;
	}

	bt_conn_cb_register(&conn_callbacks);
	bt_conn_auth_cb_register(&auth_cb_display);

	// init_quat();

	//Set all service threads here
	while(1){

		env_indicate();
		// quat_indicate();
		// comp_indicate();

	}

}
```

## src/MotionFX_Manager.c
```c
/**
******************************************************************************
* @file    MotionFX_Manager.c
* @author  Central LAB
* @version V3.4.0
* @date    26-Apr-2018
* @brief   Header for MotionFX_Manager.c
******************************************************************************
* @attention
*
* <h2><center>&copy; COPYRIGHT(c) 2018 STMicroelectronics</center></h2>
*
* Redistribution and use in source and binary forms, with or without modification,
* are permitted provided that the following conditions are met:
*   1. Redistributions of source code must retain the above copyright notice,
*      this list of conditions and the following disclaimer.
*   2. Redistributions in binary form must reproduce the above copyright notice,
*      this list of conditions and the following disclaimer in the documentation
*      and/or other materials provided with the distribution.
*   3. Neither the name of STMicroelectronics nor the names of its contributors
*      may be used to endorse or promote products derived from this software
*      without specific prior written permission.
*
* THIS SOFTWARE IS PROVIDED BY THE COPYRIGHT HOLDERS AND CONTRIBUTORS "AS IS"
* AND ANY EXPRESS OR IMPLIED WARRANTIES, INCLUDING, BUT NOT LIMITED TO, THE
* IMPLIED WARRANTIES OF MERCHANTABILITY AND FITNESS FOR A PARTICULAR PURPOSE ARE
* DISCLAIMED. IN NO EVENT SHALL THE COPYRIGHT HOLDER OR CONTRIBUTORS BE LIABLE
* FOR ANY DIRECT, INDIRECT, INCIDENTAL, SPECIAL, EXEMPLARY, OR CONSEQUENTIAL
* DAMAGES (INCLUDING, BUT NOT LIMITED TO, PROCUREMENT OF SUBSTITUTE GOODS OR
* SERVICES; LOSS OF USE, DATA, OR PROFITS; OR BUSINESS INTERRUPTION) HOWEVER
* CAUSED AND ON ANY THEORY OF LIABILITY, WHETHER IN CONTRACT, STRICT LIABILITY,
* OR TORT (INCLUDING NEGLIGENCE OR OTHERWISE) ARISING IN ANY WAY OUT OF THE USE
* OF THIS SOFTWARE, EVEN IF ADVISED OF THE POSSIBILITY OF SUCH DAMAGE.
*
******************************************************************************
*/

/* Includes ------------------------------------------------------------------*/
#include <stdio.h>
#include "main.h"
#include "MotionFX_Manager.h"

/* Private defines -----------------------------------------------------------*/
#define FROM_MDPS_TO_DPS    0.001
#define FROM_MGAUSS_TO_UT50 (0.1f/50.0f)
#define SAMPLETODISCARD 15
#define GBIAS_ACC_TH_SC_6X (2.0f*0.000765f)
#define GBIAS_GYRO_TH_SC_6X (2.0f*0.002f)
#define GBIAS_MAG_TH_SC_6X (2.0f*0.001500f)
#define GBIAS_ACC_TH_SC_9X (2.0f*0.000765f)
#define GBIAS_GYRO_TH_SC_9X (2.0f*0.002f)
#define GBIAS_MAG_TH_SC_9X (2.0f*0.001500f)

/* Delta time mSec for Deltafusion */
#define MOTIONFX_ENGINE_DELTATIME       0.01f

/* Exported Variables -------------------------------------------------------------*/
MFX_output_t iDataOUT;
MFX_input_t iDataIN;

/* Imported Variables -------------------------------------------------------------*/
extern float sensitivity_Mul;

extern SensorAxes_t MAG_Offset;

/* Private Variables -------------------------------------------------------------*/
static int discardedCount = 0;

static MFX_knobs_t iKnobs;
static MFX_knobs_t* ipKnobs;

/* Private function prototypes -----------------------------------------------*/


/**
  * @brief  Initialize MotionFX engine
  * @retval None
  */
void MotionFX_manager_init(void)
{
  char LibVersion[36];

  MotionFX_initialize();
  MotionFX_GetLibVersion(LibVersion);

  //ST MotionFX Engine Initializations
  ipKnobs = &iKnobs;

  MotionFX_getKnobs(ipKnobs);

  ipKnobs->gbias_acc_th_sc_6X = GBIAS_ACC_TH_SC_6X;
  ipKnobs->gbias_gyro_th_sc_6X = GBIAS_GYRO_TH_SC_6X;
  ipKnobs->gbias_mag_th_sc_6X = GBIAS_MAG_TH_SC_6X;

  ipKnobs->gbias_acc_th_sc_9X = GBIAS_ACC_TH_SC_9X;
  ipKnobs->gbias_gyro_th_sc_9X = GBIAS_GYRO_TH_SC_9X;
  ipKnobs->gbias_mag_th_sc_9X = GBIAS_MAG_TH_SC_9X;


  /* LSM6DS0 */
  ipKnobs->acc_orientation[0] ='e';
  ipKnobs->acc_orientation[1] ='n';
  ipKnobs->acc_orientation[2] ='u';

  ipKnobs->gyro_orientation[0] = 'e';
  ipKnobs->gyro_orientation[1] = 'n';
  ipKnobs->gyro_orientation[2] = 'u';

  ipKnobs->mag_orientation[0] = 'n';
  ipKnobs->mag_orientation[1] = 'e';
  ipKnobs->mag_orientation[2] = 'u';


  ipKnobs->output_type = MFX_ENGINE_OUTPUT_ENU;
  ipKnobs->LMode = 1;
  ipKnobs->modx  = 1;

  MotionFX_setKnobs(ipKnobs);

  MotionFX_enable_6X(MFX_ENGINE_DISABLE);
  MotionFX_enable_9X(MFX_ENGINE_DISABLE);

  discardedCount = 0;

  ALLMEMS1_PRINTF("Initialized %s\n\r", LibVersion);
}

/**
  * @brief  Run sensor fusion algorithm
  * @param SensorAxesRaw_t ACC_Value_Raw Acceleration value (x/y/z)
  * @param SensorAxes_t GYR_Value Gyroscope value (x/y/z)
  * @param SensorAxes_t MAG_Value Magneto value (x/y/z)
  * @retval None
  */
void MotionFX_manager_run( SensorAxesRaw_t ACC_Value_Raw,SensorAxes_t GYR_Value,SensorAxes_t MAG_Value)
{
  iDataIN.gyro[0] = GYR_Value.AXIS_X  * FROM_MDPS_TO_DPS;
  iDataIN.gyro[1] = GYR_Value.AXIS_Y  * FROM_MDPS_TO_DPS;
  iDataIN.gyro[2] = GYR_Value.AXIS_Z  * FROM_MDPS_TO_DPS;

  iDataIN.acc[0] = ACC_Value_Raw.AXIS_X * sensitivity_Mul;
  iDataIN.acc[1] = ACC_Value_Raw.AXIS_Y * sensitivity_Mul;
  iDataIN.acc[2] = ACC_Value_Raw.AXIS_Z * sensitivity_Mul;


  iDataIN.mag[0] = (MAG_Value.AXIS_X - MAG_Offset.AXIS_X) * FROM_MGAUSS_TO_UT50;
  iDataIN.mag[1] = (MAG_Value.AXIS_Y - MAG_Offset.AXIS_Y) * FROM_MGAUSS_TO_UT50;
  iDataIN.mag[2] = (MAG_Value.AXIS_Z - MAG_Offset.AXIS_Z) * FROM_MGAUSS_TO_UT50;



  if(discardedCount == SAMPLETODISCARD)
  {
    MotionFX_propagate(&iDataOUT, &iDataIN, MOTIONFX_ENGINE_DELTATIME);
    MotionFX_update(&iDataOUT, &iDataIN, MOTIONFX_ENGINE_DELTATIME, NULL);
  }
  else
  {
    discardedCount++;
  }
}

/**
 * @brief  Start 6 axes MotionFX engine
 * @retval None
 */
void MotionFX_manager_start_6X(void)
{
  MotionFX_enable_6X(MFX_ENGINE_ENABLE);
}

/**
 * @brief  Stop 6 axes MotionFX engine
 * @retval None
 */
void MotionFX_manager_stop_6X(void)
{
  MotionFX_enable_6X(MFX_ENGINE_DISABLE);
}

/**
 * @brief  Start 9 axes MotionFX engine
 * @retval None
 */
void MotionFX_manager_start_9X(void)
{
  MotionFX_enable_9X(MFX_ENGINE_ENABLE);
}

/**
 * @brief  Stop 9 axes MotionFX engine
 * @retval None
 */
void MotionFX_manager_stop_9X(void)
{
  MotionFX_enable_9X(MFX_ENGINE_DISABLE);
}

/**
* @brief  Get MotionFX Engine data Out
* @param  None
* @retval MFX_output *iDataOUT MotionFX Engine data Out
*/
MFX_output_t* MotionFX_manager_getDataOUT(void)
{
  return &iDataOUT;
}

/**
* @brief  Get MotionFX Engine data IN
* @param  None
* @retval MFX_input *iDataIN MotionFX Engine data IN
*/
MFX_input_t* MotionFX_manager_getDataIN(void)
{
  return &iDataIN;
}

/**
  * @brief  Run magnetometer calibration algorithm
  * @param  None
  * @retval None
  */
void MotionFX_manager_MagCal_run(MFX_MagCal_input_t *data_in, MFX_MagCal_output_t *data_out)
{
   MotionFX_MagCal_run(data_in);
   MotionFX_MagCal_getParams(data_out);
}


/**
 * @brief  Start magnetometer calibration
 * @param  None
 * @retval None
 */
void MotionFX_manager_MagCal_start(int sampletime)
{
  MotionFX_MagCal_init(sampletime, 1);
}


/**
 * @brief  Stop magnetometer calibration
 * @param  None
 * @retval None
 */
void MotionFX_manager_MagCal_stop(int sampletime)
{
  MotionFX_MagCal_init(sampletime, 0);
}


/**
 * @brief  Load calibration parameter from memory
 * @param  dataSize length ot the data
 * @param  data pointer to the data
 * @retval (1) fail, (0) success
 */
char MotionFX_LoadMagCalFromNVM(unsigned short int dataSize, unsigned int *data)
{
   char Success=0;
   Success= ReCallCalibrationFromMemory(dataSize / 4, (uint32_t*) data);
   return Success;
}

/**
 * @brief  Save calibration parameter to memory
 * @param  dataSize length ot the data
 * @param  data pointer to the data
 * @retval (1) fail, (0) success
 */
char MotionFX_SaveMagCalInNVM(unsigned short int dataSize, unsigned int *data)
{
  char Success=0;
  Success= SaveCalibrationToMemory(dataSize / 4, (uint32_t*) data);
  return Success;
}

/******************* (C) COPYRIGHT 2018 STMicroelectronics *****END OF FILE****/
```

## src/MotionFX_Manager.h
```c
/**
  ******************************************************************************
  * @file    MotionFX_Manager.h
  * @author  Central LAB
  * @version V3.4.0
  * @date    26-Apr-2018
  * @brief   This file includes sensor fusion interface functions
  ******************************************************************************
  * @attention
  *
  * <h2><center>&copy; COPYRIGHT(c) 2018 STMicroelectronics</center></h2>
  *
  * Redistribution and use in source and binary forms, with or without modification,
  * are permitted provided that the following conditions are met:
  *   1. Redistributions of source code must retain the above copyright notice,
  *      this list of conditions and the following disclaimer.
  *   2. Redistributions in binary form must reproduce the above copyright notice,
  *      this list of conditions and the following disclaimer in the documentation
  *      and/or other materials provided with the distribution.
  *   3. Neither the name of STMicroelectronics nor the names of its contributors
  *      may be used to endorse or promote products derived from this software
  *      without specific prior written permission.
  *
  * THIS SOFTWARE IS PROVIDED BY THE COPYRIGHT HOLDERS AND CONTRIBUTORS "AS IS"
  * AND ANY EXPRESS OR IMPLIED WARRANTIES, INCLUDING, BUT NOT LIMITED TO, THE
  * IMPLIED WARRANTIES OF MERCHANTABILITY AND FITNESS FOR A PARTICULAR PURPOSE ARE
  * DISCLAIMED. IN NO EVENT SHALL THE COPYRIGHT HOLDER OR CONTRIBUTORS BE LIABLE
  * FOR ANY DIRECT, INDIRECT, INCIDENTAL, SPECIAL, EXEMPLARY, OR CONSEQUENTIAL
  * DAMAGES (INCLUDING, BUT NOT LIMITED TO, PROCUREMENT OF SUBSTITUTE GOODS OR
  * SERVICES; LOSS OF USE, DATA, OR PROFITS; OR BUSINESS INTERRUPTION) HOWEVER
  * CAUSED AND ON ANY THEORY OF LIABILITY, WHETHER IN CONTRACT, STRICT LIABILITY,
  * OR TORT (INCLUDING NEGLIGENCE OR OTHERWISE) ARISING IN ANY WAY OUT OF THE USE
  * OF THIS SOFTWARE, EVEN IF ADVISED OF THE POSSIBILITY OF SUCH DAMAGE.
  *
  ******************************************************************************
  */

#ifndef _MOTIONFX_MANAGER_H_
#define _MOTIONFX_MANAGER_H_

#include "../inc/STM32_MotionFX_Library/Inc/motion_fx.h"
#include "main.h"

#define FROM_MGAUSS_TO_UT50 (0.1f/50.0f)
#define FROM_UT50_TO_MGAUSS 500.0f

#define SAMPLE_PERIOD       ((uint8_t)10)   /* [ms] */

/**
 * @brief  Sensor axes raw data structure definition
 */
typedef struct
{
  int16_t AXIS_X;
  int16_t AXIS_Y;
  int16_t AXIS_Z;
} SensorAxesRaw_t;

/**
 * @brief  Sensor axes data structure definition
 */
typedef struct
{
  int32_t AXIS_X;
  int32_t AXIS_Y;
  int32_t AXIS_Z;
} SensorAxes_t;

/* Exported functions ------------------------------------------------------- */
extern void MotionFX_manager_init(void);
extern void MotionFX_manager_run(SensorAxesRaw_t ACC_Value_Raw,SensorAxes_t GYR_Value,SensorAxes_t MAG_Value);
extern void MotionFX_manager_start_6X(void);
extern void MotionFX_manager_stop_6X(void);
extern void MotionFX_manager_start_9X(void);
extern void MotionFX_manager_stop_9X(void);

extern void MotionFX_manager_MagCal_run(MFX_MagCal_input_t *data_in, MFX_MagCal_output_t *data_out);
extern void MotionFX_manager_MagCal_start(int sampletime);
extern void MotionFX_manager_MagCal_stop(int sampletime);

extern MFX_output_t* MotionFX_manager_getDataOUT(void);
extern MFX_input_t* MotionFX_manager_getDataIN(void);

char MotionFX_LoadMagCalFromNVM(unsigned short int dataSize, unsigned int *data);
char MotionFX_SaveMagCalInNVM(unsigned short int dataSize, unsigned int *data);

#endif //_MOTIONFX_MANAGER_H_

/******************* (C) COPYRIGHT 2018 STMicroelectronics *****END OF FILE****/
```

## src/acc_event.c
```c
#include <zephyr/types.h>
#include <stddef.h>
#include <string.h>
#include <errno.h>
#include <sys/printk.h>
#include <sys/byteorder.h>
#include <zephyr.h>

#include <settings/settings.h>

#include <bluetooth/bluetooth.h>
#include <bluetooth/hci.h>
#include <bluetooth/conn.h>
#include <bluetooth/uuid.h>
#include <bluetooth/gatt.h>


static struct bt_uuid_128 feature_service_uuid = BT_UUID_INIT_128(
	0x1b, 0xc5, 0xd5, 0xa5, 0x02, 0x00, 0xb4, 0x9a,
	0xe1, 0x11, 0x01, 0x00, 0x00, 0x00, 0x00, 0x00);
static struct bt_uuid_128 acc_event_uuid = BT_UUID_INIT_128(
	0x1b, 0xc5, 0xd5, 0xa5, 0x02, 0x00, 0x36, 0xac,
	0xe1, 0x11, 0x01, 0x00, 0x00, 0x04, 0x00, 0x00);
static struct bt_gatt_ccc_cfg acc_event_ccc_cfg[BT_GATT_CCC_MAX] = {};
static u8_t acc_event[] = {1, 1, 1, 1, 1};
static u8_t acc_event_update;;




static void acc_event_ccc_cfg_changed(const struct bt_gatt_attr *attr, u16_t value)
{
	printf("JE SUIS RENTREEEEEE\n");
	acc_event_update = 1U;
}

static ssize_t read_acc_event(struct bt_conn *conn, const struct bt_gatt_attr *attr,
			void *buf, u16_t len, u16_t offset)
{
	const char *value = attr->user_data;

	return bt_gatt_attr_read(conn, attr, buf, len, offset, value,
				 sizeof(acc_event));
}

static ssize_t write_acc_event(struct bt_conn *conn, const struct bt_gatt_attr *attr,
			 const void *buf, u16_t len, u16_t offset, u8_t flags)
{
	u8_t *value = attr->user_data;

	if (offset + len > sizeof(acc_event)) {
		return BT_GATT_ERR(BT_ATT_ERR_INVALID_OFFSET);
	}

	memcpy(value + offset, buf, len);
	printf("JE SUIS GENIEEEEEEEEEEEEEEE\n");
	return len;
}

BT_GATT_SERVICE_DEFINE(acc_event_svc,
	BT_GATT_PRIMARY_SERVICE(&feature_service_uuid),
  BT_GATT_CHARACTERISTIC(&acc_event_uuid.uuid,
						 BT_GATT_CHRC_NOTIFY | BT_GATT_CHRC_READ | BT_GATT_CHRC_WRITE,
						 BT_GATT_PERM_READ | BT_GATT_PERM_WRITE,
						 read_acc_event, write_acc_event,
						 acc_event),
  BT_GATT_CCC(acc_event_ccc_cfg, acc_event_ccc_cfg_changed),

);

static void update_acc_event(){

}


void acc_event_notify(void)
{	/* Current Time Service updates only when time is changed */
	printf("%d\n", acc_event_update);
	if (acc_event_update){
		update_acc_event(NULL, &acc_event_svc.attrs[1], acc_event);
	}


}
```

## src/acc_gyro_mag.c
```c
#include <zephyr/types.h>
#include <stddef.h>
#include <string.h>
#include <errno.h>
#include <sys/printk.h>
#include <sys/byteorder.h>
#include <zephyr.h>

#include <settings/settings.h>

#include <bluetooth/bluetooth.h>
#include <bluetooth/hci.h>
#include <bluetooth/conn.h>
#include <bluetooth/uuid.h>
#include <bluetooth/gatt.h>


static struct bt_uuid_128 feature_service_uuid = BT_UUID_INIT_128(
	0x1b, 0xc5, 0xd5, 0xa5, 0x02, 0x00, 0xb4, 0x9a,
	0xe1, 0x11, 0x01, 0x00, 0x00, 0x00, 0x00, 0x00);
static struct bt_uuid_128 acc_gyro_mag = BT_UUID_INIT_128(
	0x1b, 0xc5, 0xd5, 0xa5, 0x02, 0x00, 0x36, 0xac,
	0xe1, 0x11, 0x01, 0x00, 0x00, 0x00, 0xE0, 0x00);
static struct bt_gatt_ccc_cfg agm_ccc_cfg[BT_GATT_CCC_MAX] = {};
static u8_t agm[] = {1, 1, 1, 1, 1, 1, 1, 1, 1, 1, 1, 1, 1, 1, 1, 1, 1, 1};
static u8_t agm_update;;




static void agm_ccc_cfg_changed(const struct bt_gatt_attr *attr, u16_t value)
{
	printf("JE SUIS RENTREEEEEE\n");
	agm_update = 1U;
}

static ssize_t read_agm(struct bt_conn *conn, const struct bt_gatt_attr *attr,
			void *buf, u16_t len, u16_t offset)
{
	const char *value = attr->user_data;

	return bt_gatt_attr_read(conn, attr, buf, len, offset, value,
				 sizeof(agm));
}

static ssize_t write_agm(struct bt_conn *conn, const struct bt_gatt_attr *attr,
			 const void *buf, u16_t len, u16_t offset, u8_t flags)
{
	u8_t *value = attr->user_data;

	if (offset + len > sizeof(agm)) {
		return BT_GATT_ERR(BT_ATT_ERR_INVALID_OFFSET);
	}

	memcpy(value + offset, buf, len);
	printf("JE SUIS GENIEEEEEEEEEEEEEEE\n");
	return len;
}

BT_GATT_SERVICE_DEFINE(agm_svc,
	BT_GATT_PRIMARY_SERVICE(&feature_service_uuid),
  BT_GATT_CHARACTERISTIC(&acc_gyro_mag.uuid,
						 BT_GATT_CHRC_NOTIFY | BT_GATT_CHRC_READ | BT_GATT_CHRC_WRITE,
						 BT_GATT_PERM_READ | BT_GATT_PERM_WRITE,
						 read_agm, write_agm,
						 agm),
  BT_GATT_CCC(agm_ccc_cfg, agm_ccc_cfg_changed),

);

static void update_agm(){

}


void agm_notify(void)
{	/* Current Time Service updates only when time is changed */
	printf("%d\n", agm_update);
	if (agm_update){
		update_agm(NULL, &agm_svc.attrs[1], agm);
	}


}
```

## src/battery.c
```c
#include <errno.h>
#include <init.h>
#include <misc/__assert.h>
#include <stdbool.h>
#include <zephyr/types.h>

#include <bluetooth/bluetooth.h>
#include <bluetooth/conn.h>
#include <bluetooth/gatt.h>
#include <bluetooth/uuid.h>

#define LOG_LEVEL CONFIG_BT_GATT_bat_LOG_LEVEL
#include <logging/log.h>
LOG_MODULE_REGISTER(blvl);

static u8_t blvl_update;
static u8_t indicating;
static struct bt_gatt_indicate_params ind_params;

static struct bt_uuid_128 feature_service_uuid = BT_UUID_INIT_128(
	0x1b, 0xc5, 0xd5, 0xa5, 0x02, 0x00, 0xb4, 0x9a,
	0xe1, 0x11, 0x01, 0x00, 0x00, 0x00, 0x00, 0x00);
static struct bt_uuid_128 battery_uuid = BT_UUID_INIT_128(
	0x1b, 0xc5, 0xd5, 0xa5, 0x02, 0x00, 0x36, 0xac,
	0xe1, 0x11, 0x01, 0x00, 0x00, 0x00, 0x02, 0x00);

static struct bt_gatt_ccc_cfg  blvl_ccc_cfg[BT_GATT_CCC_MAX] = {};

static void blvl_ccc_cfg_changed(const struct bt_gatt_attr *attr, u16_t value)
{
	blvl_update = (value == BT_GATT_CCC_INDICATE) ? 1 : 0;
}

static void indicate_blvl(struct bt_conn *conn, const struct bt_gatt_attr *attr,
			u8_t err)
{
	printk("Compass indication %s\n", err != 0U ? "fail" : "success");
	indicating = 0U;
}


BT_GATT_SERVICE_DEFINE(blvl_svc,
	BT_GATT_PRIMARY_SERVICE(&feature_service_uuid),
	BT_GATT_CHARACTERISTIC(&battery_uuid.uuid,
						 BT_GATT_CHRC_INDICATE,
						 BT_GATT_PERM_NONE,
						 NULL, NULL, NULL),
	BT_GATT_CCC(blvl_ccc_cfg, blvl_ccc_cfg_changed),
);

static void update_blvl(void){

	static u8_t blvl_buf[9];
	u32_t soc = 0x00U;
	u32_t voltage = 0x00U;
	u32_t current = 0x00U;
	u32_t status = 0x03U;

	memcpy(blvl_buf, &soc, 2);
	memcpy(blvl_buf+2U, &soc, 2);
	memcpy(blvl_buf+2U, &voltage, 2);
	memcpy(blvl_buf+2U, &current, 2);
	memcpy(blvl_buf+2U, &status, 2);

	ind_params.attr = &blvl_svc.attrs[2];
	ind_params.func = indicate_blvl;
	ind_params.data = &blvl_buf;
	ind_params.len = sizeof(blvl_buf);
	if (bt_gatt_indicate(NULL, &ind_params) == 0) {
		indicating = 1U;
	}

}

/*static int bas_init(struct device *dev)
{
	ARG_UNUSED(dev);

	return 0;
}

u8_t bt_gatt_bas_get_battery_level(void)
{
	return battery_level;
}*/


void blvl_indicate(void){
	if (blvl_update){
		if(indicating){
			return;
		}
		k_sleep(MSEC_PER_SEC);
		update_blvl();
		k_sleep(2000);
	}
}
```

## src/command.c
```c
#include <zephyr/types.h>
#include <stddef.h>
#include <string.h>
#include <errno.h>
#include <sys/printk.h>
#include <sys/byteorder.h>
#include <zephyr.h>

#include <bluetooth/bluetooth.h>
#include <bluetooth/hci.h>
#include <bluetooth/conn.h>
#include <bluetooth/uuid.h>
#include <bluetooth/gatt.h>

/*It is this service that notifies the user how to use certain serives
 (quaternions, compass, ...). We implemented it just for that*/

static struct bt_uuid_128 config_control_service_uuid = BT_UUID_INIT_128(
	0x1b, 0xc5, 0xd5, 0xa5, 0x02, 0x00, 0xb4, 0x9a,
	0xe1, 0x11, 0x0f, 0x00, 0x00, 0x00, 0x00, 0x00);
static struct bt_uuid_128 feature_command_uuid = BT_UUID_INIT_128(
	0x1b, 0xc5, 0xd5, 0xa5, 0x02, 0x00, 0x36, 0xac,
	0xe1, 0x11, 0x0f, 0x00, 0x02, 0x00, 0x00, 0x00);
static u8_t cmd;
static u8_t cmd_update;


static void cmd_ccc_cfg_changed(const struct bt_gatt_attr *attr, u16_t value)
{
	/* TODO: Handle value */
}

static ssize_t write_without_rsp_cmd(struct bt_conn *conn,
				     const struct bt_gatt_attr *attr,
				     const void *buf, u16_t len, u16_t offset,
				     u8_t flags)
{
	u8_t *value = attr->user_data;

	/* Write request received. Reject it since this char only accepts
	 * Write Commands.
	 */
	if (!(flags & BT_GATT_WRITE_FLAG_CMD)) {
		return BT_GATT_ERR(BT_ATT_ERR_WRITE_REQ_REJECTED);
	}

	if (offset + len > sizeof(cmd)) {
		return BT_GATT_ERR(BT_ATT_ERR_INVALID_OFFSET);
	}

	memcpy(value + offset, buf, len);
	cmd_update = 1U;

	return len;
}

BT_GATT_SERVICE_DEFINE(cmd_svc,
	BT_GATT_PRIMARY_SERVICE(&config_control_service_uuid),
  BT_GATT_CHARACTERISTIC(&feature_command_uuid.uuid,
		BT_GATT_CHRC_NOTIFY | BT_GATT_CHRC_WRITE_WITHOUT_RESP,
		BT_GATT_PERM_WRITE, NULL,
		write_without_rsp_cmd,
		&cmd),
  BT_GATT_CCC(cmd_ccc_cfg_changed),
);



void cmd_notify(void)
{	/* Current Time Service updates only when time is changed */
	if (!cmd_update) {
		return;
	}

	cmd_update = 0U;
	bt_gatt_notify(NULL, &cmd_svc.attrs[1], &cmd, sizeof(cmd));
}
```

## src/compass.c
```c
#include <zephyr/types.h>
#include <stddef.h>
#include <string.h>
#include <errno.h>
#include <sys/printk.h>
#include <sys/byteorder.h>
#include <zephyr.h>

#include <settings/settings.h>

#include <bluetooth/bluetooth.h>
#include <bluetooth/hci.h>
#include <bluetooth/conn.h>
#include <bluetooth/uuid.h>
#include <bluetooth/gatt.h>

#include "main.h"

extern float q3;

static struct bt_uuid_128 feature_service_uuid = BT_UUID_INIT_128(
	0x1b, 0xc5, 0xd5, 0xa5, 0x02, 0x00, 0xb4, 0x9a,
	0xe1, 0x11, 0x01, 0x00, 0x00, 0x00, 0x00, 0x00);
static struct bt_uuid_128 compass_uuid = BT_UUID_INIT_128(
	0x1b, 0xc5, 0xd5, 0xa5, 0x02, 0x00, 0x36, 0xac,
	0xe1, 0x11, 0x01, 0x00, 0x40, 0x00, 0x00, 0x00);

static struct bt_gatt_ccc_cfg comp_ccc_cfg[BT_GATT_CCC_MAX] = {};
static u8_t comp_buf[4];
static u8_t comp_ind;
static u8_t indicating;
static struct bt_gatt_indicate_params ind_params;

static void comp_ccc_cfg_changed(const struct bt_gatt_attr *attr, u16_t value)
{
	comp_ind = (value == BT_GATT_CCC_INDICATE) ? 1 : 0;
}

static void indicate_comp(struct bt_conn *conn, const struct bt_gatt_attr *attr,
			u8_t err)
{
	printk("Compass indication %s\n", err != 0U ? "fail" : "success");
	indicating = 0U;
}

BT_GATT_SERVICE_DEFINE(comp_svc,
	BT_GATT_PRIMARY_SERVICE(&feature_service_uuid),
  BT_GATT_CHARACTERISTIC(&compass_uuid.uuid,
						 BT_GATT_CHRC_INDICATE,
						 BT_GATT_PERM_NONE,
						 NULL, NULL, NULL),
  BT_GATT_CCC(comp_ccc_cfg, comp_ccc_cfg_changed),

);

static void update_comp(void){

	printf("w: %.1f\n", &q3);
	memcpy(comp_buf, &q3, 2);
	memcpy(comp_buf, &q3, 2);

	ind_params.attr = &comp_svc.attrs[2];
	ind_params.func = indicate_comp;
	ind_params.data = &comp_buf;
	ind_params.len = sizeof(comp_buf);
	if (bt_gatt_indicate(NULL, &ind_params) == 0) {
		indicating = 1U;
	}
}

void comp_indicate(void){
	if (comp_ind){
		if(indicating){
			return;
		}
		k_sleep(MSEC_PER_SEC);
		update_comp();
		k_sleep(100);
	}
}
```

## src/environmental.c
```c
#include <zephyr/types.h>
#include <stddef.h>
#include <string.h>
#include <errno.h>
#include <sys/printk.h>
#include <sys/byteorder.h>
#include <zephyr.h>

#include <settings/settings.h>

#include <bluetooth/bluetooth.h>
#include <bluetooth/hci.h>
#include <bluetooth/conn.h>
#include <bluetooth/uuid.h>
#include <bluetooth/gatt.h>

#include <bluetooth/services/hrs.h>
#include <bluetooth/services/bas.h>
// #include <bluetooth/services/cts.h>

#include <device.h>
#include <drivers/sensor.h>
#include <stdio.h>
#include <sys/util.h>

#ifdef CONFIG_BOARD_DISCO_L475_IOT1
#define PRESSURE_SENSOR_LABEL DT_INST_0_ST_LPS22HB_PRESS_LABEL
#else
#define PRESSURE_SENSOR_LABEL DT_INST_0_ST_LPS25HB_PRESS_LABEL
#endif

//Environmental Service AND Feature UUIDs
static struct bt_uuid_128 feature_service_uuid = BT_UUID_INIT_128(
	0x1b, 0xc5, 0xd5, 0xa5, 0x02, 0x00, 0xb4, 0x9a,
	0xe1, 0x11, 0x01, 0x00, 0x00, 0x00, 0x00, 0x00);
static struct bt_uuid_128 env_uuid = BT_UUID_INIT_128(
	0x1b, 0xc5, 0xd5, 0xa5, 0x02, 0x00, 0x36, 0xac,
	0xe1, 0x11, 0x01, 0x00, 0x00, 0x00, 0x1c, 0x00);

//BT variable declarations
static u8_t env_update;
static u8_t indicating;
static struct bt_gatt_indicate_params ind_params;


static void env_ccc_cfg_changed(const struct bt_gatt_attr *attr, u16_t value)
{
	env_update = (value == BT_GATT_CCC_INDICATE) ? 1 : 0;
}

//BT thread indication
static void indicate_env(struct bt_conn *conn, const struct bt_gatt_attr *attr,
			u8_t err)
{
	printk("Environmental indication %s\n", err != 0U ? "fail" : "success");
	indicating = 0U;
}

//Bluetooth characteristics declaration
BT_GATT_SERVICE_DEFINE(env_svc,
	BT_GATT_PRIMARY_SERVICE(&feature_service_uuid),
  BT_GATT_CHARACTERISTIC(&env_uuid.uuid,
		BT_GATT_CHRC_INDICATE,
		BT_GATT_PERM_NONE,
		NULL, NULL, NULL),
  BT_GATT_CCC(env_ccc_cfg_changed),

);

//Update environmental values
static void update_env(void)
{
	struct sensor_value temp, hum, press;
	struct device *hts221 = device_get_binding(DT_INST_0_ST_HTS221_LABEL);
	struct device *lps25hb = device_get_binding(PRESSURE_SENSOR_LABEL);

	static u8_t env_buf[10];

	if (hts221 == NULL) {
		printf("Could not get HTS221 device\n");
		return;
	}

	if (lps25hb == NULL) {
		printf("Could not get LPS25HB device\n");
		return;
	}


	k_sleep(MSEC_PER_SEC);

	if (sensor_sample_fetch(hts221) < 0) {
		printf("HTS221 Sensor sample update error\n");
		return;
	}
	if (sensor_sample_fetch(lps25hb) < 0) {
		printf("LPS25HB Sensor sample update error\n");
		return;
  }

	/* Get sensor data */

	sensor_channel_get(hts221, SENSOR_CHAN_AMBIENT_TEMP, &temp);
	sensor_channel_get(hts221, SENSOR_CHAN_HUMIDITY, &hum);
	sensor_channel_get(lps25hb, SENSOR_CHAN_PRESS, &press);

	/* Display sensor data */

	/* Erase previous */
	printf("\0033\014");

	printf("X-NUCLEO-IKS01A1 sensor dashboard\n\n");

	/* temperature */
	printf("HTS221: Temperature: %.1f C\n",
		sensor_value_to_double(&temp));

	/* humidity */
	printf("HTS221: Relative Humidity: %.1f%%\n",
		sensor_value_to_double(&hum));

	/* pressure */
	printf("LPS25HB: Pressure:%.1f kpa\n",
				sensor_value_to_double(&press));


	/*Convert to little endian and app format data*/
	u32_t pr = sys_cpu_to_le32(sensor_value_to_double(&press)*1000);
	u16_t hu = sys_cpu_to_le16(sensor_value_to_double(&hum)*10);
	u16_t tp = sys_cpu_to_le16(sensor_value_to_double(&temp)*10);
	u8_t buf_pos;
	static u16_t dummy;


	memcpy(env_buf, &dummy, 2); //Init buffer
	buf_pos = 2U;
	memcpy(env_buf+buf_pos, &pr, 4);
	buf_pos += 4U;
	memcpy(env_buf+buf_pos, &hu, 2);
	buf_pos += 2U;
	memcpy(env_buf+buf_pos, &tp, 2);

	//Send Environmetal data
	ind_params.attr = &env_svc.attrs[2];
	ind_params.func = indicate_env;
	ind_params.data = &env_buf;
	ind_params.len = sizeof(env_buf);
	if (bt_gatt_indicate(NULL, &ind_params) == 0) {
		indicating = 1U;
	}

}

//Enviromental thread
void env_indicate(void){
	if (env_update){
		if(indicating){
			return;
		}
		k_sleep(MSEC_PER_SEC);
		update_env();
		k_sleep(2000);
	}
}
```

## src/main.h
```c
#ifdef __cplusplus
extern "C" {
#endif

void env_indicate(void);
void quat_indicate(void);
void comp_indicate(void);
void init_quat(void);
void cmd_notify(void);


#ifdef __cplusplus
}
#endif
```

## src/quaternions.c
```c
#include <zephyr/types.h>
#include <stddef.h>
#include <string.h>
#include <errno.h>
#include <sys/printk.h>
#include <sys/byteorder.h>
#include <zephyr.h>

#include <settings/settings.h>

#include <bluetooth/bluetooth.h>
#include <bluetooth/hci.h>
#include <bluetooth/conn.h>
#include <bluetooth/uuid.h>
#include <bluetooth/gatt.h>

#include <device.h>
#include <drivers/sensor.h>
#include <stdio.h>
#include <stdint.h>
#include <sys/util.h>

// Update quaternion variables
#define sampleFreq	512.0f			// sample frequency in Hz
#define twoKpDef	(2.0f * 0.5f)	// 2 * proportional gain
#define twoKiDef	(2.0f * 0.0f)	// 2 * integral gain

static float twoKp = twoKpDef;											// 2 * proportional gain (Kp)
static float twoKi = twoKiDef;											// 2 * integral gain (Ki)
static float q0 = 1.0f, q1 = 0.0f, q2 = 0.0f; 					// quaternion of sensor
float q3 = 0.0f; //Euler angle
static float integralFBx = 0.0f,  integralFBy = 0.0f, integralFBz = 0.0f;	// integral error terms scaled by Ki

/*
Update Quaternion Function declarations
These functions can be replaced by imported library functions
*/
static float invSqrt(float x);
static void genius(float ax, float ay, float az, float mx, float my,
	float mz, float gx, float gy, float gz);
static void error(float ax, float ay, float az, float gx, float gy, float gz);
static float sqrt(float value);

//Quaternions Service and Feature UUIDs
static struct bt_uuid_128 feature_service_uuid = BT_UUID_INIT_128(
	0x1b, 0xc5, 0xd5, 0xa5, 0x02, 0x00, 0xb4, 0x9a,
	0xe1, 0x11, 0x01, 0x00, 0x00, 0x00, 0x00, 0x00);
static struct bt_uuid_128 quaternions_uuid = BT_UUID_INIT_128(
	0x1b, 0xc5, 0xd5, 0xa5, 0x02, 0x00, 0x36, 0xac,
	0xe1, 0x11, 0x01, 0x00, 0x00, 0x01, 0x00, 0x00);

// Quaternions Variable declarations
static u8_t quat_buf[8];
static u8_t quat_ind;
static u8_t indicating;
static struct bt_gatt_indicate_params ind_params;
struct sensor_value accel_xyz[3], gyro_xyz[3], magn_xyz[3];
struct device *lis3mdl;
struct device *lsm6ds0;


//Compass Service UUIDs
static struct bt_uuid_128 compass_uuid = BT_UUID_INIT_128(
	0x1b, 0xc5, 0xd5, 0xa5, 0x02, 0x00, 0x36, 0xac,
	0xe1, 0x11, 0x01, 0x00, 0x40, 0x00, 0x00, 0x00);

//Compass Variable declarations
static u8_t comp_buf[4];
static u8_t comp_ind;
static u8_t indicating2;
static struct bt_gatt_indicate_params ind_params2;

//Quaternions bluetooth fonctions
static void quat_ccc_cfg_changed(const struct bt_gatt_attr *attr, u16_t value)
{
	quat_ind = (value == BT_GATT_CCC_INDICATE) ? 1 : 0;
}

//Quaternions thread indication
static void indicate_quat(struct bt_conn *conn, const struct bt_gatt_attr *attr,
	u8_t err)
{
	printk("Quaternions indication %s\n", err != 0U ? "fail" : "success");
	indicating = 0U;
}

//Compass bluetooth fonctions
static void comp_ccc_cfg_changed(const struct bt_gatt_attr *attr, u16_t value)
{
	comp_ind = (value == BT_GATT_CCC_INDICATE) ? 1 : 0;
}

//Compass thread indication
static void indicate_comp(struct bt_conn *conn, const struct bt_gatt_attr *attr,
	u8_t err)
{
	printk("Compass indication %s\n", err != 0U ? "fail" : "success");
	indicating2 = 0U;
}

//Bluetooth characteristics declaration
BT_GATT_SERVICE_DEFINE(quat_svc,
	BT_GATT_PRIMARY_SERVICE(&feature_service_uuid),
	BT_GATT_CHARACTERISTIC(&quaternions_uuid.uuid,
		BT_GATT_CHRC_INDICATE,
		BT_GATT_PERM_NONE,
		NULL, NULL, NULL),
	BT_GATT_CCC(quat_ccc_cfg_changed),
	BT_GATT_CHARACTERISTIC(&compass_uuid.uuid,
		BT_GATT_CHRC_INDICATE,
		BT_GATT_PERM_NONE,
		NULL, NULL, NULL),
	BT_GATT_CCC(comp_ccc_cfg_changed),

);

//Initialize Quaternions Service
void init_quat(void){

	lis3mdl = device_get_binding(DT_INST_0_ST_LIS3MDL_MAGN_LABEL);
	lsm6ds0 = device_get_binding(DT_INST_0_ST_LSM6DS0_LABEL);

	if (lis3mdl == NULL) {
		printf("Could not get LIS3MDL device\n");
		return;
	}
	if (lsm6ds0 == NULL) {
		printf("Could not get LSM6DS0 device\n");
		return;
	}

}

static float sqrt(float value)
{
	int i;
	float sqrt = value / 3;

	if (value <= 0) {
		return 0;
	}

	for (i = 0; i < 6; i++) {
		sqrt = (sqrt + value / sqrt) / 2;
	}

	return sqrt;
}

static void genius(float ax, float ay, float az, float mx, float my,
	float mz, float gx, float gy, float gz){

	float recipNorm;
	float q0q0, q0q1, q0q2, q0q3, q1q1, q1q2, q1q3, q2q2, q2q3, q3q3;
	float hx, hy, bx, bz;
	float halfvx, halfvy, halfvz, halfwx, halfwy, halfwz;
	float halfex, halfey, halfez;
	float qa, qb, qc;

// Use error algorithm (avoids NaN in magnetometer normalisation)
	if((mx == 0.0f) && (my == 0.0f) && (mz == 0.0f)) {
		error(gx, gy, gz, ax, ay, az);
		return;
	}

// Compute feedback only if accelerometer measurement valid (avoids NaN in accelerometer normalisation)
	if(!((ax == 0.0f) && (ay == 0.0f) && (az == 0.0f))) {

		// Normalise accelerometer measurement
		recipNorm = invSqrt(ax * ax + ay * ay + az * az);
		ax *= recipNorm;
		ay *= recipNorm;
		az *= recipNorm;

		// Normalise magnetometer measurement
		recipNorm = invSqrt(mx * mx + my * my + mz * mz);
		mx *= recipNorm;
		my *= recipNorm;
		mz *= recipNorm;

		// Auxiliary variables to avoid repeated arithmetic
		q0q0 = q0 * q0;
		q0q1 = q0 * q1;
		q0q2 = q0 * q2;
		q0q3 = q0 * q3;
		q1q1 = q1 * q1;
		q1q2 = q1 * q2;
		q1q3 = q1 * q3;
		q2q2 = q2 * q2;
		q2q3 = q2 * q3;
		q3q3 = q3 * q3;

		// Reference direction of Earth's magnetic field
		hx = 2.0f * (mx * (0.5f - q2q2 - q3q3) + my * (q1q2 - q0q3) + mz * (q1q3 + q0q2));
		hy = 2.0f * (mx * (q1q2 + q0q3) + my * (0.5f - q1q1 - q3q3) + mz * (q2q3 - q0q1));
		bx = sqrt(hx * hx + hy * hy);
		bz = 2.0f * (mx * (q1q3 - q0q2) + my * (q2q3 + q0q1) + mz * (0.5f - q1q1 - q2q2));

		// Estimated direction of gravity and magnetic field
		halfvx = q1q3 - q0q2;
		halfvy = q0q1 + q2q3;
		halfvz = q0q0 - 0.5f + q3q3;
		halfwx = bx * (0.5f - q2q2 - q3q3) + bz * (q1q3 - q0q2);
		halfwy = bx * (q1q2 - q0q3) + bz * (q0q1 + q2q3);
		halfwz = bx * (q0q2 + q1q3) + bz * (0.5f - q1q1 - q2q2);

		// Error is sum of cross product between estimated direction and measured direction of field vectors
		halfex = (ay * halfvz - az * halfvy) + (my * halfwz - mz * halfwy);
		halfey = (az * halfvx - ax * halfvz) + (mz * halfwx - mx * halfwz);
		halfez = (ax * halfvy - ay * halfvx) + (mx * halfwy - my * halfwx);

		// Compute and apply integral feedback if enabled
		if(twoKi > 0.0f) {
			integralFBx += twoKi * halfex * (1.0f / sampleFreq);	// integral error scaled by Ki
			integralFBy += twoKi * halfey * (1.0f / sampleFreq);
			integralFBz += twoKi * halfez * (1.0f / sampleFreq);
			gx += integralFBx;	// apply integral feedback
			gy += integralFBy;
			gz += integralFBz;
		}
		else {
			integralFBx = 0.0f;	// prevent integral windup
			integralFBy = 0.0f;
			integralFBz = 0.0f;
		}

		// Apply proportional feedback
		gx += twoKp * halfex;
		gy += twoKp * halfey;
		gz += twoKp * halfez;

	}

	// Integrate rate of change of quaternion
	gx *= (0.5f * (1.0f / sampleFreq));		// pre-multiply common factors
	gy *= (0.5f * (1.0f / sampleFreq));
	gz *= (0.5f * (1.0f / sampleFreq));
	qa = q0;
	qb = q1;
	qc = q2;
	q0 += (-qb * gx - qc * gy - q3 * gz);
	q1 += (qa * gx + qc * gz - q3 * gy);
	q2 += (qa * gy - qb * gz + q3 * gx);
	q3 += (qa * gz + qb * gy - qc * gx);

	// Normalise quaternion
	recipNorm = invSqrt(q0 * q0 + q1 * q1 + q2 * q2 + q3 * q3);
	q0 *= recipNorm;
	q1 *= recipNorm;
	q2 *= recipNorm;
	q3 *= recipNorm;

}

static void error(float ax, float ay, float az, float gx, float gy, float gz){

	float recipNorm;
	float halfvx, halfvy, halfvz;
	float halfex, halfey, halfez;
	float qa, qb, qc;

	// Compute feedback only if accelerometer measurement valid (avoids NaN in accelerometer normalisation)
	if(!((ax == 0.0f) && (ay == 0.0f) && (az == 0.0f))) {

		// Normalise accelerometer measurement
		recipNorm = invSqrt(ax * ax + ay * ay + az * az);
		ax *= recipNorm;
		ay *= recipNorm;
		az *= recipNorm;

		// Estimated direction of gravity and vector perpendicular to magnetic flux
		halfvx = q1 * q3 - q0 * q2;
		halfvy = q0 * q1 + q2 * q3;
		halfvz = q0 * q0 - 0.5f + q3 * q3;

		// Error is sum of cross product between estimated and measured direction of gravity
		halfex = (ay * halfvz - az * halfvy);
		halfey = (az * halfvx - ax * halfvz);
		halfez = (ax * halfvy - ay * halfvx);

		// Compute and apply integral feedback if enabled
		if(twoKi > 0.0f) {
			integralFBx += twoKi * halfex * (1.0f / sampleFreq);	// integral error scaled by Ki
			integralFBy += twoKi * halfey * (1.0f / sampleFreq);
			integralFBz += twoKi * halfez * (1.0f / sampleFreq);
			gx += integralFBx;	// apply integral feedback
			gy += integralFBy;
			gz += integralFBz;
		}
		else {
			integralFBx = 0.0f;	// prevent integral windup
			integralFBy = 0.0f;
			integralFBz = 0.0f;
		}

		// Apply proportional feedback
		gx += twoKp * halfex;
		gy += twoKp * halfey;
		gz += twoKp * halfez;
	}

	// Integrate rate of change of quaternion
	gx *= (0.5f * (1.0f / sampleFreq));		// pre-multiply common factors
	gy *= (0.5f * (1.0f / sampleFreq));
	gz *= (0.5f * (1.0f / sampleFreq));
	qa = q0;
	qb = q1;
	qc = q2;
	q0 += (-qb * gx - qc * gy - q3 * gz);
	q1 += (qa * gx + qc * gz - q3 * gy);
	q2 += (qa * gy - qb * gz + q3 * gx);
	q3 += (qa * gz + qb * gy - qc * gx);

	// Normalise quaternion
	recipNorm = invSqrt(q0 * q0 + q1 * q1 + q2 * q2 + q3 * q3);
	q0 *= recipNorm;
	q1 *= recipNorm;
	q2 *= recipNorm;
	q3 *= recipNorm;

}

static float invSqrt(float x) {
	float halfx = 0.5f * x;
	float y = x;
	long i = *(long*)&y;
	i = 0x5f3759df - (i>>1);
	y = *(float*)&i;
	y = y * (1.5f - (halfx * y * y));
	return y;
}



//Update quaternions including Compass
static void update_quat(){

	if (sensor_sample_fetch(lis3mdl) < 0) {
	  printf("LIS3MDL Sensor sample update error\n");
	  return;
	 }
	if (sensor_sample_fetch(lsm6ds0) < 0) {
	  printf("LSM6DS0 Sensor sample update error\n");
	  return;
	}

	/* Erase previous */
	printf("\0033\014");

	sensor_channel_get(lis3mdl, SENSOR_CHAN_MAGN_XYZ, magn_xyz);
	sensor_channel_get(lsm6ds0, SENSOR_CHAN_ACCEL_XYZ, accel_xyz);
	sensor_channel_get(lsm6ds0, SENSOR_CHAN_GYRO_XYZ, gyro_xyz);

	float m_x = sensor_value_to_double(&magn_xyz[0]);
	float m_y = sensor_value_to_double(&magn_xyz[1]);
	float m_z = sensor_value_to_double(&magn_xyz[2]);

	float a_x = sensor_value_to_double(&accel_xyz[0]);
	float a_y = sensor_value_to_double(&accel_xyz[1]);
	float a_z = sensor_value_to_double(&accel_xyz[2]);

	float g_x = sensor_value_to_double(&gyro_xyz[0]);
	float g_y = sensor_value_to_double(&gyro_xyz[1]);
	float g_z = sensor_value_to_double(&gyro_xyz[2]);

	/* magneto data */
	printf(
		"LIS3MDL: Magnetic field (gauss): x: %.1f, y: %.1f, z: %.1f\n",
		m_x, m_y, m_z);

	/* acceleration */
	printf(
		"LSM6DS0: Acceleration (m.s-2): x: %.1f, y: %.1f, z: %.1f\n",
		a_x, a_y, a_z);

	/* gyroscope */
	printf(
		"LSM6DS0: Gyroscope (dps): x: %.3f, y: %.3f, z: %.3f\n",
		g_x, g_y, g_z);

	//Take acc gyr & mag data to obtain quaternions data
	genius(a_x, a_y, a_z, m_x, m_y, m_z, g_x, g_y, g_z);
	printf("Quaternions: x: %.1f, y: %.1f, z: %.1f, w: %.1f\n", q0, q1, q2, q3);


	u8_t buf_pos;

	static u16_t q_x, q_y, q_z, w, dummy;

	//Convert to app format data
	q_x = sys_cpu_to_le16(q0 * 10000);
	q_y = sys_cpu_to_le16(q1 * 10000);
	q_z = sys_cpu_to_le16(q2 * 10000);

	/*
	Angle range : -180° to 180°;

	ST BLE Sensor Angle range : 0 to 360°
	Positif Angle 0° to 180°
	Negatif Angle 180° to 360°
	*/
	if (q3<0){
		w = sys_cpu_to_le16((1 - q3) * 180 * 100);//Euler angle
	}
	else{
		w = sys_cpu_to_le16(q3 * 180 * 100);//Euler angle
	}


	memcpy(quat_buf, &dummy , 2); //init buf value
	buf_pos = 2U;
	memcpy(quat_buf+buf_pos, &q_x, 2);
	buf_pos += 2U;
	memcpy(quat_buf+buf_pos, &q_y, 2);
	buf_pos += 2U;
	memcpy(quat_buf+buf_pos, &q_z, 2);

	//Compass part
	memcpy(comp_buf, &w, 2);
	memcpy(comp_buf+2U, &w, 2);

	//Send Quaternions buffer
	ind_params.attr = &quat_svc.attrs[2];
	ind_params.func = indicate_quat;
	ind_params.data = &quat_buf;
	ind_params.len = sizeof(quat_buf);
	if (bt_gatt_indicate(NULL, &ind_params) == 0) {
		indicating = 1U;
	}

	//Send Compass buffer
	ind_params2.attr = &quat_svc.attrs[4];
	ind_params2.func = indicate_comp;
	ind_params2.data = &comp_buf;
	ind_params2.len = sizeof(comp_buf);
	if (bt_gatt_indicate(NULL, &ind_params2) == 0) {
		indicating2 = 1U;
	}

}

// Quaternions thread
void quat_indicate(void){
	if (quat_ind){
		if(indicating){
			return;
		}
		k_sleep(MSEC_PER_SEC);
		update_quat();
		k_sleep(100);
	}
}


// Compass thread
void comp_indicate(void){
	if (comp_ind){
		if(indicating2){
			return;
		}
		k_sleep(MSEC_PER_SEC);
		update_quat();
		k_sleep(100);
	}
}
```

## src/register.c
```c
#include <zephyr/types.h>
#include <stddef.h>
#include <string.h>
#include <errno.h>
#include <sys/printk.h>
#include <sys/byteorder.h>
#include <zephyr.h>

#include <bluetooth/bluetooth.h>
#include <bluetooth/hci.h>
#include <bluetooth/conn.h>
#include <bluetooth/uuid.h>
#include <bluetooth/gatt.h>


static struct bt_uuid_128 config_control_service_uuid = BT_UUID_INIT_128(
	0x1b, 0xc5, 0xd5, 0xa5, 0x02, 0x00, 0xb4, 0x9a,
	0xe1, 0x11, 0x0f, 0x00, 0x00, 0x00, 0x00, 0x00);

static struct bt_uuid_128 register_access_uuid = BT_UUID_INIT_128(
	0x1b, 0xc5, 0xd5, 0xa5, 0x02, 0x00, 0x36, 0xac,
	0xe1, 0x11, 0x0f, 0x00, 0x01, 0x00, 0x00, 0x00);
static struct bt_gatt_ccc_cfg reg_ccc_cfg[BT_GATT_CCC_MAX] = {};
static u8_t reg;
static u8_t reg_update;


static void reg_ccc_cfg_changed(const struct bt_gatt_attr *attr, u16_t value)
{
	/* TODO: Handle value */
}

static ssize_t read_reg(struct bt_conn *conn, const struct bt_gatt_attr *attr,
			void *buf, u16_t len, u16_t offset)
{
	const char *value = attr->user_data;

	return bt_gatt_attr_read(conn, attr, buf, len, offset, value,
				 sizeof(reg));
}

static ssize_t write_reg(struct bt_conn *conn, const struct bt_gatt_attr *attr,
			 const void *buf, u16_t len, u16_t offset, u8_t flags)
{
	u8_t *value = attr->user_data;

	if (offset + len > sizeof(reg)) {
		return BT_GATT_ERR(BT_ATT_ERR_INVALID_OFFSET);
	}

	memcpy(value + offset, buf, len);
	reg_update = 1U;

	return len;
}

BT_GATT_SERVICE_DEFINE(reg_svc,
	BT_GATT_PRIMARY_SERVICE(&config_control_service_uuid),
	BT_GATT_CHARACTERISTIC(&register_access_uuid.uuid,
						 BT_GATT_CHRC_READ | BT_GATT_CHRC_WRITE |
						 BT_GATT_CHRC_INDICATE,
						 BT_GATT_PERM_READ_ENCRYPT |
						 BT_GATT_PERM_WRITE_ENCRYPT,
						 read_reg, write_reg, &reg),
  BT_GATT_CCC(reg_ccc_cfg, reg_ccc_cfg_changed),
);

static void update_register()
{

}



void reg_notify(void)
{	/* Current Time Service updates only when time is changed */
	if (!reg_update) {
		return;
	}

	reg_update = 0U;
	bt_gatt_notify(NULL, &reg_svc.attrs[1], &reg, sizeof(reg));
}
```

## src/stderr.c
```c
#include <zephyr/types.h>
#include <stddef.h>
#include <string.h>
#include <errno.h>
#include <sys/printk.h>
#include <sys/byteorder.h>
#include <zephyr.h>

#include <bluetooth/bluetooth.h>
#include <bluetooth/hci.h>
#include <bluetooth/conn.h>
#include <bluetooth/uuid.h>
#include <bluetooth/gatt.h>


static struct bt_uuid_128 debug_service_uuid = BT_UUID_INIT_128(
	0x1b, 0xc5, 0xd5, 0xa5, 0x02, 0x00, 0xb4, 0x9a,
	0xe1, 0x11, 0x0e, 0x00, 0x00, 0x00, 0x00, 0x00);
static struct bt_uuid_128 stderr_uuid = BT_UUID_INIT_128(
	0x1b, 0xc5, 0xd5, 0xa5, 0x02, 0x00, 0x36, 0xac,
	0xe1, 0x11, 0x0e, 0x00, 0x02, 0x00, 0x00, 0x00);
static struct bt_gatt_ccc_cfg stderr_ccc_cfg[BT_GATT_CCC_MAX] = {};
static u8_t stderr;
static u8_t stderr_update;


static void stderr_ccc_cfg_changed(const struct bt_gatt_attr *attr, u16_t value)
{
	/* TODO: Handle value */
}

static ssize_t write_without_rsp_stderr(struct bt_conn *conn,
				     const struct bt_gatt_attr *attr,
				     const void *buf, u16_t len, u16_t offset,
				     u8_t flags)
{
	u8_t *value = attr->user_data;

	/* Write request received. Reject it since this char only accepts
	 * Write Commands.
	 */
	if (!(flags & BT_GATT_WRITE_FLAG_CMD)) {
		return BT_GATT_ERR(BT_ATT_ERR_WRITE_REQ_REJECTED);
	}

	if (offset + len > sizeof(stderr)) {
		return BT_GATT_ERR(BT_ATT_ERR_INVALID_OFFSET);
	}

	memcpy(value + offset, buf, len);
	stderr_update = 1U;

	return len;
}

BT_GATT_SERVICE_DEFINE(stderr_svc,
	BT_GATT_PRIMARY_SERVICE(&debug_service_uuid),
	BT_GATT_CHARACTERISTIC(&stderr_uuid.uuid,
						 BT_GATT_CHRC_NOTIFY | BT_GATT_CHRC_READ,
						 BT_GATT_PERM_WRITE,
						 NULL, write_without_rsp_stderr,
						 &stderr),
  BT_GATT_CCC(stderr_ccc_cfg, stderr_ccc_cfg_changed),
);

static void update_stderr()
{

}



void stderr_notify(void)
{	/* Current Time Service updates only when time is changed */
	if (!stderr_update) {
		return;
	}

	stderr_update = 0U;
	bt_gatt_notify(NULL, &stderr_svc.attrs[1], &stderr, sizeof(stderr));
}
```
